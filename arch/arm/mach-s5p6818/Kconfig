## arch/arm/mach-s5p6818/Kconfig
```kconfig
#
# Copyright 2009 Nexell.
#		http://www.nexell.co.kr
#
if ARCH_S5P6818

choice
	prompt "Memory max order"
	default S5P6818_MEM_MAX_ORDER_11

	config S5P6818_MEM_MAX_ORDER_11
		bool "4Mbyte"

	config S5P6818_MEM_MAX_ORDER_12
    	bool "8Mbyte"

	config S5P6818_MEM_MAX_ORDER_13
		bool "16Mbyte"

endchoice

config FORCE_MAX_ZONEORDER
   	int
   	default 11 if S5P6818_MEM_MAX_ORDER_11
   	default 12 if S5P6818_MEM_MAX_ORDER_12
   	default 13 if S5P6818_MEM_MAX_ORDER_13

endif
```

## drivers/platform/Kconfig
```kconfig
if X86
source "drivers/platform/x86/Kconfig"
endif
if GOLDFISH
source "drivers/platform/goldfish/Kconfig"
endif
if PLAT_SLSIAP 
source "drivers/platform/nexell/Kconfig"
endif

source "drivers/platform/chrome/Kconfig"
```

## drivers/platform/nexell/Kconfig
```kconfig
#
# Copyright 2009 Nexell.
#		http://www.nexell.co.kr
#
# Select Board types

if ARCH_S5P6818
source "drivers/platform/nexell/s5p6818/Kconfig"
endif
```

## drivers/platform/nexell/s5p6818/board/Kconfig
```kconfig
#
# Copyright 2009 Nexell.
#
config ARCH_S5P6818_BOARD
	bool "s5p6818 Board Feactures"
	default n
	depends on ARCH_S5P6818

choice
    prompt "Type"
    default ARCH_S5P6818_SVT
    depends on ARCH_S5P6818_BOARD

   	config ARCH_S5P6818_SVT
		bool "SVT: Validation Board"
		help
   	 		Support for the Validation Board (SVT).

   	config ARCH_S5P6818_ASB
		bool "ASB: Validation Board"
		help
   	 		Support for the Validation Board (ASB).
endchoice

if ARCH_S5P6818_SVT
source "drivers/platform/nexell/s5p6818/board/svt/Kconfig"
endif
```

## drivers/platform/nexell/s5p6818/board/svt/Kconfig
```kconfig
#
# Copyright 2009 Nexell.
#


choice
    prompt "SVT"
    default ARCH_S5P6818_SVT_LINUX
    depends on ARCH_S5P6818_SVT

   	config ARCH_S5P6818_SVT_LINUX
		bool "Linux"

   	config ARCH_S5P6818_SVT_ANDROID
		bool "Android"
endchoice

choice
    prompt "ASV margin"
    default S5P6818_MARGIN_SVT_TYPICAL
    depends on ARCH_S5P6818_SVT

   	config S5P6818_MARGIN_SVT_TYPICAL
		bool "typical"

   	config S5P6818_MARGIN_SVT_MINUS_3
		bool "-3%"

   	config S5P6818_MARGIN_SVT_MINUS_5
		bool "-5%"

endchoice
```

## drivers/platform/nexell/s5p6818/cpu/Kconfig
```kconfig
#
# Copyright 2009 Nexell.
#
menu "SLsiAP s5p6818"

choice
	prompt "Prototype build mode"
	default S5P6818_PROTO_RELEASE

	config S5P6818_PROTO_RELEASE
		bool "Release"

	config S5P6818_PROTO_DEBUG
		bool "Debug"
endchoice

config S5P6818_PM_IDLE
	bool "Goto idle when Suspend"
	depends on SUSPEND
	default n

source "drivers/platform/nexell/s5p6818/board/Kconfig"

endmenu
```

## drivers/platform/nexell/s5p6818/target/Kconfig
```kconfig
#
# Copyright 2009 Nexell.
#
config ARCH_S5P6818_TARGET
	bool "s5p6818 Target Feactures"
	default n
	depends on ARCH_S5P6818

choice
    prompt "Type"
    depends on ARCH_S5P6818_TARGET

   	config ARCH_S5P6818_SVT
		bool "SVT: validation board"
		help
   	 		Support for the validation board (SVT).

   	config ARCH_S5P6818_ASB
		bool "ASB: validation board"
		help
   	 		Support for the ASB board (ASB).
endchoice

if ARCH_S5P6818_SVT
source "drivers/platform/nexell/s5p6818/target/svt/Kconfig"
endif
```
